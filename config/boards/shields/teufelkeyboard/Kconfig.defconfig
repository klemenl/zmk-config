## config/boards/shields/teufelkeyboard/Kconfig.defconfig
```kconfig
if SHIELD_TEUFELKEYBOARD

config ZMK_KEYBOARD_NAME
    default "TeufelKeyboard"

endif
```

## config/boards/shields/teufelremote/Kconfig.defconfig
```kconfig
if SHIELD_TEUFELREMOTE

config ZMK_KEYBOARD_NAME
    default "TeufelRemote"

config ZMK_USB_LOGGING
    default y

config BT_CTLR_PRIVACY_SUPPORT
    default n

endif
```
